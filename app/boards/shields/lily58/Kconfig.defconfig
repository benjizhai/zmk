## app/boards/shields/lily58/Kconfig.defconfig
```kconfig
if SHIELD_LILY58_LEFT

config ZMK_KEYBOARD_NAME
	default "Lily58 Left"

endif

if SHIELD_LILY58_RIGHT

config ZMK_KEYBOARD_NAME
	default "Lily58 Right"

endif

if SHIELD_LILY58_LEFT || SHIELD_LILY58_RIGHT

if ZMK_DISPLAY

config I2C
	default y

config SSD1306
	default y

config SSD1306_REVERSE_MODE
	default y

endif # ZMK_DISPLAY



endif
```
